	/* 0x00 _ */ (uint8_t *)"\x01\x00",
	/* 0x01 _ */ (uint8_t *)"\x01\x00",
	/* 0x02 _ */ (uint8_t *)"\x01\x00",
	/* 0x03 _ */ (uint8_t *)"\x01\x00",
	/* 0x04 _ */ (uint8_t *)"\x01\x00",
	/* 0x05 _ */ (uint8_t *)"\x01\x00",
	/* 0x06 _ */ (uint8_t *)"\x07\x18\x1c\x0e\x18\x30\x40\x80",
	/* 0x07 _ */ (uint8_t *)"\x01\x00",
	/* 0x08 _ */ (uint8_t *)"\x01\x00",
	/* 0x09 _ */ (uint8_t *)"\x01\x00",
	/* 0x0a _ */ (uint8_t *)"\x01\x00",
	/* 0x0b _ */ (uint8_t *)"\x01\x00",
	/* 0x0c _ */ (uint8_t *)"\x01\x00",
	/* 0x0d _ */ (uint8_t *)"\x01\x00",
	/* 0x0e _ */ (uint8_t *)"\x01\x00",
	/* 0x0f _ */ (uint8_t *)"\x01\x00",
	/* 0x10 _ */ (uint8_t *)"\x01\x00",
	/* 0x11 _ */ (uint8_t *)"\x01\x00",
	/* 0x12 _ */ (uint8_t *)"\x01\x00",
	/* 0x13 _ */ (uint8_t *)"\x01\x00",
	/* 0x14 _ */ (uint8_t *)"\x01\x00",
	/* 0x15 _ */ (uint8_t *)"\x07\x44\xee\x7c\x38\x7c\xee\x44",
	/* 0x16 _ */ (uint8_t *)"\x01\x00",
	/* 0x17 _ */ (uint8_t *)"\x01\x00",
	/* 0x18 _ */ (uint8_t *)"\x01\x00",
	/* 0x19 _ */ (uint8_t *)"\x01\x00",
	/* 0x1a _ */ (uint8_t *)"\x01\x00",
	/* 0x1b _ */ (uint8_t *)"\x01\x00",
	/* 0x1c _ */ (uint8_t *)"\x01\x00",
	/* 0x1d _ */ (uint8_t *)"\x01\x00",
	/* 0x1e _ */ (uint8_t *)"\x01\x00",
	/* 0x1f _ */ (uint8_t *)"\x01\x00",
	/* 0x20   */ (uint8_t *)"\x01\x00",
	/* 0x21 ! */ (uint8_t *)"\x03\x60\xfa\x60",
	/* 0x22 " */ (uint8_t *)"\x05\x00\xe0\x00\xe0\x00",
	/* 0x23 # */ (uint8_t *)"\x05\x6c\xfe\x6c\xfe\x6c",
	/* 0x24 $ */ (uint8_t *)"\x05\x32\xff\x5a\xff\x4c",
	/* 0x25 % */ (uint8_t *)"\x05\xc2\xcc\x10\x66\x86",
	/* 0x26 & */ (uint8_t *)"\x05\x5c\xa2\xb2\x4c\x1a",
	/* 0x27 ' */ (uint8_t *)"\x05\x00\x00\xe0\x00\x00",
	/* 0x28 ( */ (uint8_t *)"\x03\x38\x44\x82",
	/* 0x29 ) */ (uint8_t *)"\x03\x82\x44\x38",
	/* 0x2a * */ (uint8_t *)"\x05\x44\x28\xfe\x28\x44",
	/* 0x2b + */ (uint8_t *)"\x05\x10\x10\x7c\x10\x10",
	/* 0x2c , */ (uint8_t *)"\x03\x01\x06\x00",
	/* 0x2d - */ (uint8_t *)"\x04\x10\x10\x10\x10",
	/* 0x2e . */ (uint8_t *)"\x03\x00\x02\x00",
	/* 0x2f / */ (uint8_t *)"\x03\x06\x38\xc0",
	/* 0x30 0 */ (uint8_t *)"\x05\x7c\x82\x92\x82\x7c",
	/* 0x31 1 */ (uint8_t *)"\x05\x22\x42\xfe\x02\x02",
	/* 0x32 2 */ (uint8_t *)"\x05\x42\x86\x8a\x92\x62",
	/* 0x33 3 */ (uint8_t *)"\x05\x44\x82\x92\x92\x6c",
	/* 0x34 4 */ (uint8_t *)"\x05\x18\x28\x48\x88\xfe",
	/* 0x35 5 */ (uint8_t *)"\x05\xf4\x92\x92\x92\x8c",
	/* 0x36 6 */ (uint8_t *)"\x05\x7c\x92\x92\x92\x4c",
	/* 0x37 7 */ (uint8_t *)"\x05\x80\x80\x8e\xb0\xc0",
	/* 0x38 8 */ (uint8_t *)"\x05\x6c\x92\x92\x92\x6c",
	/* 0x39 9 */ (uint8_t *)"\x05\x64\x92\x92\x92\x7c",
	/* 0x3a : */ (uint8_t *)"\x03\x00\x24\x00",
	/* 0x3b ; */ (uint8_t *)"\x03\x01\x26\x00",
	/* 0x3c < */ (uint8_t *)"\x04\x10\x28\x44\x82",
	/* 0x3d = */ (uint8_t *)"\x04\x28\x28\x28\x28",
	/* 0x3e > */ (uint8_t *)"\x04\x82\x44\x28\x10",
	/* 0x3f ? */ (uint8_t *)"\x05\x40\x80\x9a\xa0\x40",
	/* 0x40 @ */ (uint8_t *)"\x05\x7c\x82\x9a\xaa\x72",
	/* 0x41 A */ (uint8_t *)"\x05\x7e\x90\x90\x90\x7e",
	/* 0x42 B */ (uint8_t *)"\x05\xfe\x92\x92\x92\x6c",
	/* 0x43 C */ (uint8_t *)"\x05\x7c\x82\x82\x82\x44",
	/* 0x44 D */ (uint8_t *)"\x05\xfe\x82\x82\x82\x7c",
	/* 0x45 E */ (uint8_t *)"\x05\xfe\x92\x92\x92\x82",
	/* 0x46 F */ (uint8_t *)"\x05\xfe\x90\x90\x90\x80",
	/* 0x47 G */ (uint8_t *)"\x05\x7c\x82\x82\x92\x5c",
	/* 0x48 H */ (uint8_t *)"\x05\xfe\x10\x10\x10\xfe",
	/* 0x49 I */ (uint8_t *)"\x05\x82\x82\xfe\x82\x82",
	/* 0x4a J */ (uint8_t *)"\x05\x04\x02\x02\x82\xfc",
	/* 0x4b K */ (uint8_t *)"\x05\xfe\x10\x28\x44\x82",
	/* 0x4c L */ (uint8_t *)"\x05\xfe\x02\x02\x02\x02",
	/* 0x4d M */ (uint8_t *)"\x05\xfe\x40\x30\x40\xfe",
	/* 0x4e N */ (uint8_t *)"\x05\xfe\x40\x38\x04\xfe",
	/* 0x4f O */ (uint8_t *)"\x05\x7c\x82\x82\x82\x7c",
	/* 0x50 P */ (uint8_t *)"\x05\xfe\x90\x90\x90\x60",
	/* 0x51 Q */ (uint8_t *)"\x05\x7c\x82\x8a\x84\x7a",
	/* 0x52 R */ (uint8_t *)"\x05\xfe\x90\x98\x94\x62",
	/* 0x53 S */ (uint8_t *)"\x05\x64\x92\x92\x92\x4c",
	/* 0x54 T */ (uint8_t *)"\x05\x80\x80\xfe\x80\x80",
	/* 0x55 U */ (uint8_t *)"\x05\xfc\x02\x02\x02\xfc",
	/* 0x56 V */ (uint8_t *)"\x05\xe0\x18\x06\x18\xe0",
	/* 0x57 W */ (uint8_t *)"\x05\xfc\x02\x1c\x02\xfc",
	/* 0x58 X */ (uint8_t *)"\x05\xc6\x28\x10\x28\xc6",
	/* 0x59 Y */ (uint8_t *)"\x05\xc0\x20\x1e\x20\xc0",
	/* 0x5a Z */ (uint8_t *)"\x05\x86\x8a\x92\xa2\xc2",
	/* 0x5b [ */ (uint8_t *)"\x03\xfe\x82\x82",
	/* 0x5c \ */ (uint8_t *)"\x03\xe0\x38\x0e",
	/* 0x5d ] */ (uint8_t *)"\x03\x82\x82\xfe",
	/* 0x5e ^ */ (uint8_t *)"\x03\x60\xc0\x60",
	/* 0x5f _ */ (uint8_t *)"\x05\x02\x02\x02\x02\x02",
	/* 0x60 ` */ (uint8_t *)"\x05\x00\x80\x40\x20\x00",
	/* 0x61 a */ (uint8_t *)"\x05\x04\x2a\x2a\x2a\x1e",
	/* 0x62 b */ (uint8_t *)"\x05\xfe\x22\x22\x22\x1c",
	/* 0x63 c */ (uint8_t *)"\x05\x1c\x22\x22\x22\x14",
	/* 0x64 d */ (uint8_t *)"\x05\x1c\x22\x22\x22\xfe",
	/* 0x65 e */ (uint8_t *)"\x05\x1c\x2a\x2a\x2a\x1a",
	/* 0x66 f */ (uint8_t *)"\x05\x10\x7e\x90\x80\x40",
	/* 0x67 g */ (uint8_t *)"\x05\x18\x25\x25\x25\x3e",
	/* 0x68 h */ (uint8_t *)"\x05\xfe\x10\x20\x20\x1e",
	/* 0x69 i */ (uint8_t *)"\x05\x00\x22\xbe\x02\x00",
	/* 0x6a j */ (uint8_t *)"\x05\x02\x01\x21\xbe\x00",
	/* 0x6b k */ (uint8_t *)"\x05\xfe\x08\x14\x22\x00",
	/* 0x6c l */ (uint8_t *)"\x05\x80\x80\xfc\x02\x02",
	/* 0x6d m */ (uint8_t *)"\x05\x3e\x20\x1e\x20\x1e",
	/* 0x6e n */ (uint8_t *)"\x05\x3e\x10\x20\x20\x1e",
	/* 0x6f o */ (uint8_t *)"\x05\x1c\x22\x22\x22\x1c",
	/* 0x70 p */ (uint8_t *)"\x05\x3f\x24\x24\x24\x18",
	/* 0x71 q */ (uint8_t *)"\x05\x18\x24\x24\x24\x3f",
	/* 0x72 r */ (uint8_t *)"\x05\x3e\x10\x20\x20\x10",
	/* 0x73 s */ (uint8_t *)"\x05\x12\x2a\x2a\x2a\x24",
	/* 0x74 t */ (uint8_t *)"\x05\x20\x20\xfc\x22\x22",
	/* 0x75 u */ (uint8_t *)"\x05\x3c\x02\x02\x02\x3e",
	/* 0x76 v */ (uint8_t *)"\x05\x30\x0c\x02\x0c\x30",
	/* 0x77 w */ (uint8_t *)"\x05\x3c\x02\x0c\x02\x3c",
	/* 0x78 x */ (uint8_t *)"\x05\x22\x36\x08\x36\x22",
	/* 0x79 y */ (uint8_t *)"\x05\x38\x05\x05\x05\x3e",
	/* 0x7a z */ (uint8_t *)"\x05\x22\x26\x2a\x32\x22",
	/* 0x7b { */ (uint8_t *)"\x04\x10\x7c\xee\x82",
	/* 0x7c | */ (uint8_t *)"\x03\x00\xfe\x00",
	/* 0x7d } */ (uint8_t *)"\x04\x82\xee\x7c\x10",
	/* 0x7e ~ */ (uint8_t *)"\x05\x18\x20\x10\x08\x30",
	/* 0x7f _ */ (uint8_t *)"\x01\x00",
