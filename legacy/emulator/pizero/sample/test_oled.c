#include <stdio.h>
#include <stdint.h>
#include <string.h>
#include <bcm2835.h>

#include "oled_drivers.h"

// Sample program to test the oled driver.
// It displays the trezor logo on the oled display and exit
// You can customize OLED_TYPE and FLIP variables to match your device.
// Refers to oled_drivers.h for supported oled.
// Note that the bcm2835 library must be installed on your system
uint8_t OLED_TYPE = 5;
bool FLIP = false;

typedef struct {
  uint8_t width, height;
  const uint8_t *data;
} BITMAP;

#define OLED_WIDTH 128
#define OLED_HEIGHT 64
#define OLED_BUFSIZE (OLED_WIDTH * OLED_HEIGHT / 8)

static uint8_t _oledbuffer[OLED_BUFSIZE];
const uint8_t bmp_logo64_data[] = { 0x00, 0x00, 0x00, 0x00, 0x00, 0x00, 0x00, 0x00, 0x00, 0x00, 0x00, 0x00, 0x00,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 0x00, };
const BITMAP bmp_logo64 = {48, 64, bmp_logo64_data};

#define OLED_OFFSET(x, y) (OLED_BUFSIZE - 1 - (x) - ((y) / 8) * OLED_WIDTH)
#define OLED_MASK(x, y) (1 << (7 - (y) % 8))

void oledDrawPixel(int x, int y) {
  if ((x < 0) || (y < 0) || (x >= OLED_WIDTH) || (y >= OLED_HEIGHT)) {
    return;
  }
  _oledbuffer[OLED_OFFSET(x, y)] |= OLED_MASK(x, y);
}

void oledClearPixel(int x, int y) {
  if ((x < 0) || (y < 0) || (x >= OLED_WIDTH) || (y >= OLED_HEIGHT)) {
    return;
  }
  _oledbuffer[OLED_OFFSET(x, y)] &= ~OLED_MASK(x, y);
}

void oledDrawBitmap(int x, int y, const BITMAP *bmp) {
  for (int i = 0; i < bmp->width; i++) {
    for (int j = 0; j < bmp->height; j++) {
      if (bmp->data[(i / 8) + j * bmp->width / 8] & (1 << (7 - i % 8))) {
        oledDrawPixel(x + i, y + j);
      } else {
        oledClearPixel(x + i, y + j);
      }
    }
  }
}

int main() {
  bcm2835_init();
  bool init_done = oled_init(OLED_TYPE, FLIP);
  if (!init_done) {
    fprintf(stderr, "Failed to initialize oled");
    return 1;
  }

  memset(_oledbuffer, 0, sizeof(_oledbuffer));
  oledDrawBitmap(40, 0, &bmp_logo64);
  oled_display(_oledbuffer);
  return 0;
}
