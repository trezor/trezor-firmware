## nordic/trezor/west.yml
```yaml
# Copyright (c) 2021 Nordic Semiconductor ASA
# SPDX-License-Identifier: Apache-2.0

manifest:
  self:
    west-commands: scripts/west-commands.yml

  remotes:
    - name: ncs
      url-base: https://github.com/nrfconnect

  projects:
    - name: nrf
      remote: ncs
      repo-path: sdk-nrf
      revision: ba167d9f3db4abbdc9b67887ca3ea66c64f2d956 #v3.3.0
      import: true
    - name: mcuboot
      url: https://github.com/trezor/mcuboot
      revision: 77e36dc737ef9ca0d30503a39f4b00a89d7b3de4 #tychovrahe/trezor-ncs3.3.0/pq2
      path: bootloader/mcuboot
```
