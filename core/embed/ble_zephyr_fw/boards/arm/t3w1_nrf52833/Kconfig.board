## core/embed/ble_zephyr_fw/boards/arm/t3w1_nrf52833/Kconfig.board
```kconfig
# nRF52833 DK NRF52833 board configuration

# Copyright (c) 2019 Nordic Semiconductor ASA
# SPDX-License-Identifier: Apache-2.0

config BOARD_T3W1_NRF52833
	bool "T3W1 NRF52833"
	depends on SOC_NRF52833_QIAA
```

## nordic/trezor/boards/arm/picodk/Kconfig.picodk
```kconfig
# Copyright (c) 2025 Nordic Semiconductor ASA
# SPDX-License-Identifier: LicenseRef-Nordic-5-Clause

config BOARD_PICODK
	select SOC_NRF54LS05B_CPUAPP if BOARD_PICODK_NRF54LS05B_CPUAPP
```

## nordic/trezor/boards/arm/picodk/board.yml
```yaml
board:
  name: picodk
  full_name: nRF54LS05B DK
  vendor: nordic
  socs:
  - name: nrf54ls05b
  revision:
    format: major.minor.patch
    default: "0.2.0"
    revisions:
    - name: "0.0.0"
    - name: "0.2.0"
```

## nordic/trezor/boards/arm/picodk/picodk_nrf54ls05b_cpuapp_defconfig
```kconfig
# Copyright (c) 2025 Nordic Semiconductor ASA
# SPDX-License-Identifier: LicenseRef-Nordic-5-Clause

# Enable UART driver
CONFIG_SERIAL=y

# Enable console
CONFIG_CONSOLE=y
CONFIG_UART_CONSOLE=y

# Enable GPIO
CONFIG_GPIO=y

# Enable hardware stack protection
CONFIG_HW_STACK_PROTECTION=y

CONFIG_MODEL_IDENTIFIER=827798356
```

## nordic/trezor/boards/arm/t3t2_dk/Kconfig.defconfig
```kconfig
# Copyright (c) 2025 Nordic Semiconductor ASA
# SPDX-License-Identifier: LicenseRef-Nordic-5-Clause

if BOARD_T3T2_DK_NRF54LS05B_CPUAPP

config ROM_START_OFFSET
	default 0 if PARTITION_MANAGER_ENABLED
	default 0x800 if BOOTLOADER_MCUBOOT

config SOC_NRF54LX_SKIP_GLITCHDETECTOR_DISABLE
	default y

config NRF_RRAM_WRITE_BUFFER_SIZE
	default 8

endif # BOARD_T3T2_DK_NRF54LS05B_CPUAPP
```

## nordic/trezor/boards/arm/t3t2_dk/Kconfig.t3t2_dk
```kconfig
# Copyright (c) 2025 Nordic Semiconductor ASA
# SPDX-License-Identifier: LicenseRef-Nordic-5-Clause

config BOARD_T3T2_DK
	select SOC_NRF54LS05B_CPUAPP if BOARD_T3T2_DK_NRF54LS05B_CPUAPP
```

## nordic/trezor/boards/arm/t3t2_dk/board.yml
```yaml
board:
  name: t3t2_dk
  full_name: t3t2_dk
  vendor: trezor
  socs:
  - name: nrf54ls05b
```

## nordic/trezor/boards/arm/t3w1_d1_nrf52833/Kconfig.t3w1_d1_nrf52833
```kconfig
# nRF52833 DK NRF52833 board configuration

# Copyright (c) 2019 Nordic Semiconductor ASA
# SPDX-License-Identifier: Apache-2.0

config BOARD_T3W1_D1_NRF52833
	select SOC_NRF52833_QIAA
```

## nordic/trezor/boards/arm/t3w1_d1_nrf52833/board.yml
```yaml
# Copyright (c) 2024 Nordic Semiconductor ASA
# SPDX-License-Identifier: Apache-2.0

board:
  name: t3w1_d1_nrf52833
  vendor: vendor
  socs:
    - name: nrf52833
```

## nordic/trezor/boards/arm/t3w1_revA_nrf52832/Kconfig.defconfig
```kconfig
# T3W1 REVA NRF52833 board configuration

# Copyright (c) 2019 Nordic Semiconductor ASA
# SPDX-License-Identifier: Apache-2.0

if BOARD_T3W1_REVA_NRF52832

config BOARD
	default "t3w1_revA_nrf52832"

config BT_CTLR
	default BT

endif # BOARD_T3W1_REVA_NRF52832
```

## nordic/trezor/boards/arm/t3w1_revA_nrf52832/board.yml
```yaml
# Copyright (c) 2024 Nordic Semiconductor ASA
# SPDX-License-Identifier: Apache-2.0

board:
  name: t3w1_revA_nrf52832
  full_name: t3w1_revA_nrf52832
  vendor: trezor
  socs:
    - name: nrf52832
```

## nordic/trezor/direct_test_mode/boards/nrf5340dk_nrf5340_cpunet_hci.conf
```kconfig
#
# Copyright (c) 2021 Nordic Semiconductor
#
# SPDX-License-Identifier: LicenseRef-Nordic-5-Clause
#

CONFIG_IPC_SERVICE=y
CONFIG_IPC_SERVICE_BACKEND_RPMSG=y
CONFIG_MBOX=y

CONFIG_NRFX_GPPI=y

CONFIG_HEAP_MEM_POOL_SIZE=4096

CONFIG_NRF_RPC=y
CONFIG_NRF_RPC_CBOR=y

CONFIG_NET_BUF=y
```

## nordic/trezor/direct_test_mode/boards/nrf54h20dk_nrf54h20_cpurad.conf
```kconfig
#
# Copyright (c) 2024 Nordic Semiconductor
#
# SPDX-License-Identifier: LicenseRef-Nordic-5-Clause
#

# Disable the unsupported driver
CONFIG_NRFX_TIMER0=n
CONFIG_NRFX_TIMER1=n
CONFIG_NRFX_TIMER2=n

# Use necessary peripherals
CONFIG_NRFX_TIMER020=y
CONFIG_NRFX_TIMER021=y
```

## nordic/trezor/direct_test_mode/boards/nrf54l15pdk_nrf54l15_cpuapp.conf
```kconfig
#
# Copyright (c) 2023 Nordic Semiconductor
#
# SPDX-License-Identifier: LicenseRef-Nordic-5-Clause
#

# Disable the unsupported driver
CONFIG_NRFX_TIMER0=n
CONFIG_NRFX_TIMER1=n
CONFIG_NRFX_TIMER2=n

# Use necessary peripherals
CONFIG_NRFX_TIMER20=y
CONFIG_NRFX_TIMER10=y
CONFIG_NRFX_GPPI=y
```

## west/trezor/boards/arm/t3w1_d1_nrf52833/Kconfig.defconfig
```kconfig
# nRF52833 DK NRF52833 board configuration

# Copyright (c) 2019 Nordic Semiconductor ASA
# SPDX-License-Identifier: Apache-2.0

if BOARD_T3W1_D1_NRF52833

config BOARD
	default "t3w1_d1_nrf52833"

config BT_CTLR
	default BT

endif # BOARD_T3W1_NRF52833
```

## west/trezor/boards/arm/t3w1_revA_nrf52832/Kconfig.t3w1_revA_nrf52832
```kconfig
# T3W1 REVA NRF52832 board configuration

# Copyright (c) 2019 Nordic Semiconductor ASA
# SPDX-License-Identifier: Apache-2.0

config BOARD_T3W1_REVA_NRF52832
	select SOC_NRF52832_CIAA
```

## west/trezor/dts/bindings/sensor/zephyr,example-sensor.yaml
```yaml
# Copyright (c) 2021 Nordic Semiconductor ASA
# SPDX-License-Identifier: Apache-2.0

description: |
  An example sensor that reads the GPIO level defined in input-gpios. The
  purpose of this sensor is to demonstrate how to create out-of-tree drivers.

  Example definition in devicetree:

    example-sensor {
        compatible = "zephyr,example-sensor";
        input-gpios = <&gpio0 0 (GPIO_PULL_UP | GPIO_ACTIVE_LOW)>;
    };

compatible: "zephyr,example-sensor"

include: base.yaml

properties:
  input-gpios:
    type: phandle-array
    required: true
    description: Input GPIO to be sensed.
```

## west/trezor/tests/lib/custom/testcase.yaml
```yaml
common:
  tags: extensibility
  integration_platforms:
    - custom_plank
    - qemu_cortex_m0
tests:
  lib.custom: {}
  lib.custom.non_default:
    extra_args: CONFIG_CUSTOM_GET_VALUE_DEFAULT=6
```

## west/trezor/west.yml
```yaml
# Copyright (c) 2021 Nordic Semiconductor ASA
# SPDX-License-Identifier: Apache-2.0

manifest:
  self:
    west-commands: scripts/west-commands.yml

  remotes:
    - name: ncs
      url-base: https://github.com/nrfconnect

  projects:
    - name: nrf
      remote: ncs
      repo-path: sdk-nrf
      revision: v2.7.0
      import: true
```
